## drivers/media/usb/smi2021/Kconfig
```kconfig
config VIDEO_SMI2021
	tristate "Somagic SMI2021 USB video/audio capture support"
	depends on VIDEO_DEV && I2C && SND && USB
	select VIDEOBUF2_VMALLOC
	select VIDEO_SAA711X
	select SND_PCM
	help
	  This is a video4linux driver for SMI2021 based video capture devices.

	  To compile this driver as a module, choose M here: the
	  module will be called smi2021
```
